## conf/distro/pretzel-rt.conf
```bitbake
require conf/distro/pretzel.conf

DISTRO = "pretzel-rt"
DISTROOVERRIDES = "pretzel-rt:pretzel"
DISTRO_NAME = "Pretzel-RT (TQ-Systems Distribution for TQMx86 BSP)"

PREFERRED_PROVIDER_virtual/kernel = "linux-yocto-rt"
```

## conf/distro/pretzel.conf
```bitbake
INIT_MANAGER ?= "systemd"

require conf/distro/poky.conf

DISTRO = "pretzel"
DISTROOVERRIDES = "pretzel"
DISTRO_NAME = "Pretzel (TQ-Systems Distribution for TQMx86 BSP)"

DISTRO_FEATURES += "efi pam"

PREFERRED_PROVIDER_virtual/base-utils = "packagegroup-core-base-utils"
VIRTUAL-RUNTIME_base-utils = "packagegroup-core-base-utils"
VIRTUAL-RUNTIME_base-utils-hwclock = "util-linux-hwclock"
VIRTUAL-RUNTIME_base-utils-syslog = ""
VIRTUAL-RUNTIME_initscripts = ""

PACKAGECONFIG:pn-alsa-utils:append = " bat"

DISTRO_EXTRA_RRECOMMENDS += " \
    alsa-utils \
    alsa-utils-alsabat \
    can-utils \
    cpufrequtils \
    evtest \
    fb-test \
    i2c-tools \
    libgpiod-tools \
    lmsensors-sensors \
    openssh \
    ptn3460-edid-tool \
"
```
