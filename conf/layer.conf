## conf/layer.conf
```bitbake
# We have a conf and classes directory, add to BBPATH
BBPATH .= ":${LAYERDIR}"

# We have recipes-* directories, add to BBFILES
BBFILES += "${LAYERDIR}/recipes-*/*/*.bb ${LAYERDIR}/recipes-*/*/*.bbappend"

BBFILE_COLLECTIONS += "tqmx86"
BBFILE_PATTERN_tqmx86 = "^${LAYERDIR}/"
BBFILE_PRIORITY_tqmx86 = "9"

# This should only be incremented on significant changes that will
# cause compatibility issues with other layers
LAYERVERSION_tqmx86 = "1"

LAYERDEPENDS_tqmx86 = "core"

LAYERSERIES_COMPAT_tqmx86 = "sumo thud warrior zeus"
```

## conf/machine/intel-corei7-64-tqmx86.conf
```bitbake
#@TYPE: Machine
#@NAME: intel-corei7-64-tqmx86

#@DESCRIPTION: Machine configuration for TQ modules with 64 bit Intel Core i7 CPU (and later) with MMX, SSE, SSE2, SSE3, and SSSE3 instruction set support. Supports a moderately wide range of drivers that should boot and be usable on "typical" hardware.

# Disable hddimg - intel-corei7-64 adds wic type
IMAGE_FSTYPES ?= ""

PREFERRED_VERSION_linux-intel ?= "5.10%"

require conf/machine/intel-corei7-64.conf
MACHINEOVERRIDES =. "intel-corei7-64:"

MACHINEOVERRIDES =. "tqmx86:"
APPEND += "acpi_enforce_resources=lax"

SERIAL_CONSOLES = "115200;ttyS0"
```
